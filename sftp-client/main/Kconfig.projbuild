## sftp-client/main/Kconfig.projbuild
```kconfig
menu "Application Configuration"

	config ESP_WIFI_SSID
		string "WiFi SSID"
		default "myssid"
		help
			SSID (network name) for to connect to.

	config ESP_WIFI_PASSWORD
		string "WiFi Password"
		default "mypassword"
		help
			WiFi password (WPA or WPA2) to use.

	config ESP_MAXIMUM_RETRY
		int "Maximum retry"
		default 5
		help
			Set the Maximum retry to avoid station reconnecting to the AP unlimited when the AP is really inexistent.
	
	config SFTP_USER
		string "SFTP Username"
		default "sftpUser"
		help
			Username of SFTP Connection.

	config SFTP_PASSWORD
		string "SFTP Password"
		default "sftpPassword"
		help
			Password of SFTP Connection.

	config SFTP_HOST
		string "SFTP Host"
		default "sftpHost.local"
		help
			IP address or mDNS of SFTP host.

endmenu
```
